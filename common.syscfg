/**
 * These arguments were used when this file was generated. They will be automatically applied on subsequent loads
 * via the GUI or CLI. Run CLI with '--help' for additional information on how to override these arguments.
 * @cliArgs --board "/ti/boards/CC3220SF_LAUNCHXL" --product "simplelink_cc32xx_sdk@4_10_00_07"
 * @versions {"data":"2020021217","timestamp":"2020021217","tool":"1.4.0+1234","templates":"2020021217"}
 */

/**
 * Import the modules used in this configuration.
 */
const DriverLib      = scripting.addModule("/ti/devices/DriverLib");
const Display        = scripting.addModule("/ti/display/Display");
const Display1       = Display.addInstance();
const Board          = scripting.addModule("/ti/drivers/Board");
const Crypto         = scripting.addModule("/ti/drivers/Crypto");
const Crypto1        = Crypto.addInstance();
const DMA            = scripting.addModule("/ti/drivers/DMA");
const GPIO           = scripting.addModule("/ti/drivers/GPIO");
const GPIO1          = GPIO.addInstance();
const GPIO2          = GPIO.addInstance();
const GPIO3          = GPIO.addInstance();
const GPIO4          = GPIO.addInstance();
const GPIO5          = GPIO.addInstance();
const GPIO6          = GPIO.addInstance();
const GPIO7          = GPIO.addInstance();
const GPIO8          = GPIO.addInstance();
const GPIO9          = GPIO.addInstance();
const GPIO10         = GPIO.addInstance();
const GPIO11         = GPIO.addInstance();
const GPIO12         = GPIO.addInstance();
const GPIO13         = GPIO.addInstance();
const Power          = scripting.addModule("/ti/drivers/Power");
const SPI            = scripting.addModule("/ti/drivers/SPI");
const SPI1           = SPI.addInstance();
const Timer          = scripting.addModule("/ti/drivers/Timer");
const Timer1         = Timer.addInstance();
const Timer2         = Timer.addInstance();
const Timer3         = Timer.addInstance();
const Watchdog       = scripting.addModule("/ti/drivers/Watchdog");
const Watchdog1      = Watchdog.addInstance();
const SimpleLinkWifi = scripting.addModule("/ti/drivers/net/wifi/SimpleLinkWifi");
const SlNet          = scripting.addModule("/ti/net/SlNet");
const SlNet1         = SlNet.addInstance();

/**
 * Write custom configuration values to the imported modules.
 */
Display1.$name                          = "CONFIG_Display_0";
Display1.$hardware                      = system.deviceData.board.components.XDS110UART;
Display1.uart.$name                     = "CONFIG_UART_0";
Display1.uart.useDMA                    = true;
Display1.uart.uart.$name                = "MyUART1";
Display1.uart.uart.$assign              = "UART0";
Display1.uart.uart.txPin.$assign        = "GP01";
Display1.uart.uart.rxPin.$assign        = "GP02";
Display1.uart.uart.txDmaChannel.$assign = "UDMA_CH9";
Display1.uart.uart.rxDmaChannel.$assign = "UDMA_CH8";

Crypto1.$name = "CONFIG_Crypto_0";

GPIO1.$hardware       = system.deviceData.board.components.SW2;
GPIO1.$name           = "CONFIG_GPIO_BUTTON_0";
GPIO1.gpioPin.$assign = "boosterpack.3";

GPIO2.$hardware       = system.deviceData.board.components.SW3;
GPIO2.$name           = "CONFIG_GPIO_BUTTON_1";
GPIO2.gpioPin.$assign = "boosterpack.11";

GPIO3.$hardware      = system.deviceData.board.components.LED_RED;
GPIO3.outputStrength = "High";
GPIO3.$name          = "CONFIG_GPIO_LED_0";

GPIO4.$hardware      = system.deviceData.board.components.LED_YELLOW;
GPIO4.outputStrength = "High";
GPIO4.$name          = "CONFIG_GPIO_LED_1";

GPIO5.$hardware      = system.deviceData.board.components.LED_GREEN;
GPIO5.outputStrength = "High";
GPIO5.$name          = "CONFIG_GPIO_LED_2";

GPIO6.$name           = "CONFIG_GPIO_0";
GPIO6.mode            = "Dynamic";
GPIO6.gpioPin.$assign = "boosterpack.19";

GPIO7.$name           = "CONFIG_GPIO_1";
GPIO7.mode            = "Dynamic";
GPIO7.gpioPin.$assign = "boosterpack.2";

GPIO8.$name           = "CONFIG_GPIO_2";
GPIO8.mode            = "Dynamic";
GPIO8.gpioPin.$assign = "boosterpack.4";

GPIO9.$name = "CONFIG_GPIO_3";
GPIO9.mode  = "Output";

GPIO10.$name = "CONFIG_GPIO_4";
GPIO10.mode  = "Output";

GPIO11.$name = "CONFIG_GPIO_5";
GPIO11.mode  = "Output";

GPIO12.$name = "CONFIG_GPIO_6";
GPIO12.mode  = "Output";

GPIO13.$name = "CONFIG_GPIO_7";
GPIO13.mode  = "Output";

Power.ioRetentionShutdown = ["GRP_1"];
Power.parkPins.$name      = "ti_drivers_power_PowerCC32XXPins0";

SPI1.$name                    = "CONFIG_SPI_0";
SPI1.mode                     = "Four Pin SS Active Low";
SPI1.defaultTxBufferValue     = "0";
SPI1.spi.$name                = "MySPI1";
SPI1.spi.$assign              = "SPI0";
SPI1.spi.sclkPin.$assign      = "boosterpack.7";
SPI1.spi.misoPin.$assign      = "boosterpack.14";
SPI1.spi.mosiPin.$assign      = "boosterpack.15";
SPI1.spi.ssPin.$assign        = "boosterpack.18";
SPI1.spi.dmaRxChannel.$assign = "UDMA_CH6";
SPI1.spi.dmaTxChannel.$assign = "UDMA_CH7";

Timer1.$name         = "CONFIG_TIMER_0";
Timer1.timerType     = "32 Bits";
Timer1.timer.$name   = "MyTimer1";
Timer1.timer.$assign = "Timer0";

Timer2.$name         = "CONFIG_TIMER_1";
Timer2.timerType     = "32 Bits";
Timer2.timer.$name   = "MyTimer1";
Timer2.timer.$assign = "Timer1";

Timer3.$name         = "CONFIG_TIMER_2";
Timer3.timer.$name   = "MyTimer1";
Timer3.timer.$assign = "Timer2";

Watchdog1.$name            = "CONFIG_WATCHDOG_0";
Watchdog1.watchdog.$name   = "MyWATCHDOG1";
Watchdog1.watchdog.$assign = "WATCHDOG0";

SlNet1.$name  = "CONFIG_SLNET";
SlNet1.ifName = "CC32xx";

/**
 * Pinmux solution for unlocked pins/peripherals. This ensures that minor changes to the automatic solver in a future
 * version of the tool will not impact the pinmux you originally saw.  These lines can be completely deleted in order to
 * re-solve from scratch.
 */
GPIO3.gpioPin.$suggestSolution  = "64";
GPIO4.gpioPin.$suggestSolution  = "1";
GPIO5.gpioPin.$suggestSolution  = "2";
GPIO9.gpioPin.$suggestSolution  = "21";
GPIO10.gpioPin.$suggestSolution = "45";
GPIO11.gpioPin.$suggestSolution = "50";
GPIO12.gpioPin.$suggestSolution = "53";
GPIO13.gpioPin.$suggestSolution = "59";
