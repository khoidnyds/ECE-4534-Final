/**
 * @cliArgs --board "/ti/boards/CC3220SF_LAUNCHXL" --product "simplelink_cc32xx_sdk@4_10_00_07"
 * @versions {"data":"2020021217","timestamp":"2020021217","tool":"1.4.0+1234","templates":"2020021217"}
 */

/**
 * Import the modules used in this configuration.
 */
const DriverLib      = scripting.addModule("/ti/devices/DriverLib");
const Display        = scripting.addModule("/ti/display/Display");
const Display1       = Display.addInstance();
const Board          = scripting.addModule("/ti/drivers/Board");
const Crypto         = scripting.addModule("/ti/drivers/Crypto");
const Crypto1        = Crypto.addInstance();
const DMA            = scripting.addModule("/ti/drivers/DMA");
const GPIO           = scripting.addModule("/ti/drivers/GPIO", {}, false);
const GPIO1          = GPIO.addInstance();
const GPIO2          = GPIO.addInstance();
const GPIO3          = GPIO.addInstance();
const GPIO4          = GPIO.addInstance();
const GPIO5          = GPIO.addInstance();
const GPIO6          = GPIO.addInstance();
const GPIO7          = GPIO.addInstance();
const I2C            = scripting.addModule("/ti/drivers/I2C", {}, false);
const I2C1           = I2C.addInstance();
const Power          = scripting.addModule("/ti/drivers/Power");
const SPI            = scripting.addModule("/ti/drivers/SPI");
const SPI1           = SPI.addInstance();
const Timer          = scripting.addModule("/ti/drivers/Timer");
const Timer1         = Timer.addInstance();
const Timer2         = Timer.addInstance();
const Timer3         = Timer.addInstance();
const Watchdog       = scripting.addModule("/ti/drivers/Watchdog");
const Watchdog1      = Watchdog.addInstance();
const SimpleLinkWifi = scripting.addModule("/ti/drivers/net/wifi/SimpleLinkWifi");
const SlNet          = scripting.addModule("/ti/net/SlNet");
const SlNet1         = SlNet.addInstance();

/**
 * Write custom configuration values to the imported modules.
 */
Display1.$name                          = "CONFIG_Display_0";
Display1.$hardware                      = system.deviceData.board.components.XDS110UART;
Display1.uart.$name                     = "CONFIG_UART_0";
Display1.uart.useDMA                    = true;
Display1.uart.uart.$name                = "MyUART1";
Display1.uart.uart.$assign              = "UART0";
Display1.uart.uart.txPin.$assign        = "GP01";
Display1.uart.uart.rxPin.$assign        = "GP02";
Display1.uart.uart.txDmaChannel.$assign = "UDMA_CH9";
Display1.uart.uart.rxDmaChannel.$assign = "UDMA_CH8";

Crypto1.$name = "CONFIG_Crypto_0";

GPIO1.mode            = "Output";
GPIO1.pull            = "Pull Down";
GPIO1.$name           = "US_FRONT_TRIGGER";
GPIO1.gpioPin.$assign = "boosterpack.13";

GPIO2.mode            = "Output";
GPIO2.pull            = "Pull Down";
GPIO2.$name           = "US_LEFT_TRIGGER";
GPIO2.gpioPin.$assign = "boosterpack.18";

GPIO3.mode            = "Output";
GPIO3.pull            = "Pull Down";
GPIO3.$name           = "US_RIGHT_TRIGGER";
GPIO3.gpioPin.$assign = "boosterpack.19";

GPIO4.pull             = "Pull Down";
GPIO4.interruptTrigger = "Both Edges";
GPIO4.callbackFunction = "getTime";
GPIO4.$name            = "US_FRONT_ECHO";
GPIO4.gpioPin.$assign  = "boosterpack.5";

GPIO5.pull             = "Pull Down";
GPIO5.interruptTrigger = "Both Edges";
GPIO5.callbackFunction = "getTime";
GPIO5.$name            = "US_LEFT_ECHO";
GPIO5.gpioPin.$assign  = "boosterpack.8";

GPIO6.pull             = "Pull Down";
GPIO6.interruptTrigger = "Both Edges";
GPIO6.callbackFunction = "getTime";
GPIO6.$name            = "US_RIGHT_ECHO";
GPIO6.gpioPin.$assign  = "boosterpack.26";

GPIO7.$name           = "LIMIT_SWITCH";
GPIO7.pull            = "Pull Up";
GPIO7.gpioPin.$assign = "boosterpack.27";

I2C1.$name              = "CONFIG_I2C_0";
I2C1.i2c.$name          = "MyI2C1";
I2C1.i2c.$assign        = "I2C0";
I2C1.i2c.sdaPin.$assign = "boosterpack.14";
I2C1.i2c.sclPin.$assign = "boosterpack.7";

Power.ioRetentionShutdown = ["GRP_1"];
Power.parkPins.$name      = "ti_drivers_power_PowerCC32XXPins0";

SPI1.$name                    = "CONFIG_SPI_0";
SPI1.mode                     = "Four Pin SS Active Low";
SPI1.defaultTxBufferValue     = "0";
SPI1.spi.$name                = "MySPI1";
SPI1.spi.$assign              = "SPI0";
SPI1.spi.sclkPin.$assign      = "boosterpack.17";
SPI1.spi.misoPin.$assign      = "boosterpack.28";
SPI1.spi.mosiPin.$assign      = "boosterpack.15";
SPI1.spi.ssPin.$assign        = "boosterpack.30";
SPI1.spi.dmaRxChannel.$assign = "UDMA_CH6";
SPI1.spi.dmaTxChannel.$assign = "UDMA_CH7";

Timer1.$name         = "CONFIG_TIMER_0";
Timer1.timerType     = "32 Bits";
Timer1.timer.$name   = "MyTimer1";
Timer1.timer.$assign = "Timer0";

Timer2.$name       = "CONFIG_TIMER_1";
Timer2.timer.$name = "MyTimer1";

Timer3.$name       = "CONFIG_TIMER_2";
Timer3.timerType   = "32 Bits";
Timer3.timer.$name = "MyTimer1";

Watchdog1.$name            = "CONFIG_WATCHDOG_0";
Watchdog1.watchdog.$name   = "MyWATCHDOG1";
Watchdog1.watchdog.$assign = "WATCHDOG0";

SlNet1.$name  = "CONFIG_SLNET";
SlNet1.ifName = "CC32xx";

/**
 * Pinmux solution for unlocked pins/peripherals. This ensures that minor changes to the automatic solver in a future
 * version of the tool will not impact the pinmux you originally saw.  These lines can be completely deleted in order to
 * re-solve from scratch.
 */
Timer2.timer.$suggestSolution = "Timer2";
Timer3.timer.$suggestSolution = "Timer1";
